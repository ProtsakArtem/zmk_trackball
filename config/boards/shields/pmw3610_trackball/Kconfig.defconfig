## config/boards/shields/pmw3610_trackball/Kconfig.defconfig
```kconfig
if SHIELD_PMW3610_TRACKBALL

config ZMK_POINTING
    default y

config SPI
    default y

config INPUT
    default y

endif
```

## config/boards/shields/pmw3610_trackball/Kconfig.shield
```kconfig
config SHIELD_PMW3610_TRACKBALL
    def_bool $(shields_list_contains,pmw3610_trackball)
```
